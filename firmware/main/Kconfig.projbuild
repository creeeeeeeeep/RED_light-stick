## firmware/main/Kconfig.projbuild
```kconfig
menu "크라운 응원봉"

config CROWN_DEV
    bool "개발자 빌드"
    default n
    help
      켜면 모션 로그를 서버로 실시간 전송하고, 펌웨어 갱신 확인을 자주 한다.

      OTA 자체는 이 플래그와 무관하게 양쪽 빌드에 다 들어간다. 배포용 봉도
      WiFi 로 갱신해야 하기 때문이다. 이 플래그가 가르는 것은 개발 편의뿐이다.

config CROWN_OTA_CHECK_SEC
    int "펌웨어 갱신 확인 주기 (초)"
    default 5 if CROWN_DEV
    default 21600
    help
      개발 중에는 짧게 두어 구운 직후 봉이 알아채게 한다.
      배포판은 6시간이면 충분하다 — 부팅할 때도 한 번 확인한다.

endmenu
```
